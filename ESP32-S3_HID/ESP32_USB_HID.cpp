/* ESP32_USB_HID.cpp — Adafruit TinyUSB
 *
 * Requer: "Adafruit TinyUSB Library" instalada pelo Library Manager.
 *
 * Tools → USB Mode → USB-OTG (TinyUSB)  ← obrigatório
 * Tools → USB CDC On Boot → Enabled
 *
 * O descriptor HID é a cópia exata do HID.cpp original do Arduino,
 * com macros NB_BUTTONS/NB_FF_AXIS/axis bits resolvidos em literais.
 * Isso garante que o Windows FFB driver reconheça o dispositivo
 * da mesma forma que reconhece o Pro Micro/Leonardo original.
 */

#include <Arduino.h>
#include <Adafruit_TinyUSB.h>
#include "Platform.h"
#include "USBAPI.h"
#include "USBDesc.h"

// ─────────────────────────────────────────────────────────────────────────────
// HID Report Descriptor — UMA única Application Collection (Joystick)
//
// ESTRUTURA OBRIGATÓRIA para DirectInput FFB:
//   DirectInput enumera o joystick no nó HID que encontra primeiro.
//   Ele então procura reports OUTPUT/FEATURE *no mesmo nó* para FFB.
//   Duas Applications separadas criam dois nós HID distintos — o jogo
//   encontra o joystick no nó 1 mas os reports FFB estão no nó 2,
//   e nunca os associa → ffb_rx=0.
//
//   Port 1:1 do brWheel original Arduino HID.cpp (ADD_JOYSTICK),
//   com macros resolvidas: NB_BUTTONS=24, NB_FF_AXIS=2.
//   IDs originais restaurados (ID 2 = envelope OUTPUT e PID State INPUT
//   é válido em HID — direction IN vs OUT diferencia os reports).
// ─────────────────────────────────────────────────────────────────────────────
// ─────────────────────────────────────────────────────────────────────────────
static const uint8_t _hidDesc[] = {
/* ══════════════════════════════════════════════════════════════════
   ÚNICA Application Collection (Joystick + FFB/PID)
   Estrutura idêntica ao Arduino original brWheel HID.cpp
   ══════════════════════════════════════════════════════════════════ */
  0x05,0x01, 0x09,0x04, 0xA1,0x01,   // UsagePage(GenDesk), Usage(Joystick), App

  /* ── Joystick Input (Report ID 4) ─────────────────────────────── */
  0x85,0x04,                          // ReportID(4)
  0x09,0x01, 0xA1,0x00,              // Usage(Pointer), Physical

  // X axis 16-bit
  0x09,0x30,
  0x17,0x00,0x00,0x00,0x00,          // LogMin(0) [32-bit]
  0x27,0xFF,0xFF,0x00,0x00,          // LogMax(65535)
  0x35,0x00, 0x47,0xFF,0xFF,0x00,0x00,
  0x75,0x10, 0x95,0x01, 0x81,0x02,
  // Y axis 16-bit
  0x09,0x31,
  0x16,0x00,0x00, 0x27,0xFF,0xFF,0x00,0x00,
  0x35,0x00, 0x47,0xFF,0xFF,0x00,0x00,
  0x75,0x10, 0x95,0x01, 0x81,0x02,
  // Z axis 12-bit
  0x09,0x32,
  0x16,0x00,0x00, 0x27,0xFF,0x0F,0x00,0x00,
  0x35,0x00, 0x47,0xFF,0x0F,0x00,0x00,
  0x75,0x0C, 0x95,0x01, 0x81,0x02,
  // RX axis 12-bit
  0x09,0x33,
  0x16,0x00,0x00, 0x27,0xFF,0x0F,0x00,0x00,
  0x35,0x00, 0x47,0xFF,0x0F,0x00,0x00,
  0x75,0x0C, 0x95,0x01, 0x81,0x02,
  // RY axis 12-bit
  0x09,0x34,
  0x16,0x00,0x00, 0x27,0xFF,0x0F,0x00,0x00,
  0x35,0x00, 0x47,0xFF,0x0F,0x00,0x00,
  0x75,0x0C, 0x95,0x01, 0x81,0x02,
  // HAT 4-bit
  0x09,0x39, 0x15,0x01, 0x25,0x08,
  0x35,0x00, 0x46,0x3B,0x01,
  0x65,0x14, 0x55,0x00,
  0x75,0x04, 0x95,0x01, 0x81,0x02,
  // Buttons 24-bit (NB_BUTTONS=24)
  0x05,0x09, 0x15,0x00, 0x25,0x01, 0x55,0x00, 0x65,0x00,
  0x19,0x01, 0x29,0x18,
  0x75,0x01, 0x95,0x18, 0x81,0x02,
  0xC0,  // EndCollection(Physical)

  /* ── Config reports (WheelControl, brWheel compatibility) ──────── */
  0x85,0xF1,
  0x09,0x01, 0x15,0x00, 0x26,0xFF,0x00,
  0x95,0x3F, 0x75,0x08, 0x91,0x82,
  0x85,0xF2,
  0x09,0x01, 0x95,0x3F, 0x75,0x08, 0x81,0x82,

  /* ── PID State INPUT (Report ID 2) ─────────────────────────────── */
  0x05,0x0F,
  0x09,0x92, 0xA1,0x02, 0x85,0x02,
  0x09,0x9F,0x09,0xA0,0x09,0xA4,0x09,0xA5,0x09,0xA6,
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  0xC0,

  /* ── Set Effect OUTPUT (Report ID 1) ────────────────────────────── */
  0x09,0x21, 0xA1,0x02, 0x85,0x01,
  0x09,0x22, 0x15,0x01,0x25,0x28,0x35,0x01,0x45,0x28,0x75,0x08,0x95,0x01,0x91,0x02,
  0x09,0x25, 0xA1,0x02,
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  0xC0,

  /* ── Set Envelope OUTPUT (Report ID 2 — válido: direcção OUT ≠ IN) */
  0x09,0x5A, 0xA1,0x02, 0x85,0x02,
  0x09,0x22, 0x15,0x01,0x25,0x28,0x35,0x01,0x45,0x28,0x75,0x08,0x95,0x01,0x91,0x02,
  0x09,0x5B,0x09,0x5D, 0x15,0x00,0x26,0xFF,0x00,0x35,0x00,0x46,0xFF,0x7F,0x75,0x08,0x95,0x02,0x91,0x02,
  0x09,0x5C,0x09,0x5E, 0x66,0x01,0x10,0x55,0xFD, 0x26,0xFF,0x7F,0x46,0xFF,0x7F,0x75,0x10,0x95,0x02,0x91,0x02,
  0x66,0x00,0x00,0x55,0x00, 0xC0,

  /* ── Set Condition OUTPUT (Report ID 3) ─────────────────────────── */
  0x09,0x5F, 0xA1,0x02, 0x85,0x03,
  0x09,0x22, 0x15,0x01,0x25,0x28,0x35,0x01,0x45,0x28,0x75,0x08,0x95,0x01,0x91,0x02,
  0x09,0x23, 0x15,0x00,0x25,0x01,0x35,0x00,0x45,0x01,0x75,0x04,0x95,0x01,0x91,0x02,
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  0xC0,

  /* ── Set Periodic OUTPUT (Report ID 4 — válido: direcção OUT ≠ IN joystick) */
  0x09,0x6E, 0xA1,0x02, 0x85,0x04,
  0x09,0x22, 0x15,0x01,0x25,0x28,0x35,0x01,0x45,0x28,0x75,0x08,0x95,0x01,0x91,0x02,
  0x09,0x70, 0x15,0x00,0x26,0xFF,0x7F,0x35,0x00,0x46,0xFF,0x7F,0x75,0x10,0x95,0x01,0x91,0x02,
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  0xC0,

  /* ── Set Constant Force OUTPUT (Report ID 5) ────────────────────── */
  0x09,0x73, 0xA1,0x02, 0x85,0x05,
  0x09,0x22, 0x15,0x01,0x25,0x28,0x35,0x01,0x45,0x28,0x75,0x08,0x95,0x01,0x91,0x02,
  0x09,0x70, 0x16,0x01,0x80,0x26,0xFF,0x7F,0x36,0x01,0x80,0x46,0xFF,0x7F,0x75,0x10,0x95,0x01,0x91,0x02,
  0xC0,

  /* ── Set Ramp Force OUTPUT (Report ID 6) ────────────────────────── */
  0x09,0x74, 0xA1,0x02, 0x85,0x06,
  0x09,0x22, 0x15,0x01,0x25,0x28,0x35,0x01,0x45,0x28,0x75,0x08,0x95,0x01,0x91,0x02,
  0x09,0x75,0x09,0x76, 0x15,0x81,0x25,0x7F,0x36,0x01,0x80,0x46,0xFF,0x7F,
  0x75,0x08,0x95,0x02,0x91,0x02,
  0xC0,

  /* ── Effect Operation OUTPUT (Report ID 10) ─────────────────────── */
  0x09,0x77, 0xA1,0x02, 0x85,0x0A,
  0x09,0x22, 0x15,0x01,0x25,0x28,0x35,0x01,0x45,0x28,0x75,0x08,0x95,0x01,0x91,0x02,
  0x09,0x78, 0xA1,0x02,
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  0xC0,

  /* ── Block Free OUTPUT (Report ID 11) ───────────────────────────── */
  0x09,0x90, 0xA1,0x02, 0x85,0x0B,
  0x09,0x22, 0x15,0x01,0x25,0x28,0x35,0x01,0x45,0x28,0x75,0x08,0x95,0x01,0x91,0x02,
  0xC0,

  /* ── Device Control OUTPUT (Report ID 12) ───────────────────────── */
  0x09,0x96, 0xA1,0x02, 0x85,0x0C,
  0x09,0x97,0x09,0x98,0x09,0x99,0x09,0x9A,0x09,0x9B,0x09,0x9C,
  0x15,0x01,0x25,0x06,0x75,0x08,0x95,0x01,0x91,0x00,
  0xC0,

  /* ── Device Gain OUTPUT (Report ID 13) ──────────────────────────── */
  0x09,0x7D, 0xA1,0x02, 0x85,0x0D,
  0x09,0x7E, 0x15,0x00,0x26,0xFF,0x00,0x35,0x00,0x46,0x10,0x27,0x75,0x08,0x95,0x01,0x91,0x02,
  0xC0,

  /* ── Create New Effect FEATURE (Report ID 5 — direcção FEATURE ≠ OUTPUT) */
  0x09,0xAB, 0xA1,0x02, 0x85,0x05,
  0x09,0x25, 0xA1,0x02,
  0x09,0x26,0x09,0x27,0x09,0x30,0x09,0x31,0x09,0x32,
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  0xC0,

  /* ── PID Block Load FEATURE (Report ID 6 — direcção FEATURE ≠ OUTPUT) */
  0x09,0x89, 0xA1,0x02, 0x85,0x06,
  0x09,0x22, 0x25,0x28,0x15,0x01,0x35,0x01,0x45,0x28,0x75,0x08,0x95,0x01,0xB1,0x02,
  0x09,0x8B, 0xA1,0x02,
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  0xC0,

  /* ── PID Pool FEATURE (Report ID 7) ─────────────────────────────── */
  0x09,0x7F, 0xA1,0x02, 0x85,0x07,
  0x09,0x80,
  0x75,0x10,0x95,0x01,0x15,0x00,
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  0xC0,  // EndCollection(Application/Joystick) — única Application
};

static const uint16_t _hidDescLen = sizeof(_hidDesc);

// ─────────────────────────────────────────────────────────────────────────────
// Globais
// ─────────────────────────────────────────────────────────────────────────────
uint8_t  g_featureReportBuf[64] = {};
uint16_t g_featureReportLen     = 0;

// FIX: static buffer for USB_RecvControl.
// The original pointer approach had a race: set_report_cb fired (setting
// s_recvReady=true) before USB_RecvControl set s_recvBuf, so USB_RecvControl
// then reset s_recvReady=false and waited 5ms for data that never came.
// Create New Effect always returned 0 → game never allocated effect blocks.
static uint8_t        s_featureBuf[65] = {};
static volatile int   s_featureLen     = 0;
static volatile bool  s_recvReady      = false;

USBDevice_ USBDevice;
Joystick_  Joystick;
Keyboard_  Keyboard;
Mouse_     Mouse;

// ── HID device (Joystick FFB) ─────────────────────────────────────────────────
static Adafruit_USBD_HID s_HID(_hidDesc, _hidDescLen,
                                HID_ITF_PROTOCOL_NONE, 2, true);

// ─────────────────────────────────────────────────────────────────────────────
// Callbacks TinyUSB  (Adafruit TinyUSB 3.7.4)
//
// ─────────────────────────────────────────────────────────────────────────────
// Callbacks TinyUSB  (Adafruit TinyUSB 3.7.4)
//
// Assinaturas EXATAS de Adafruit_USBD_HID.h 3.7.4 (verificado pelo erro do compilador):
//   get_report_callback_t = uint16_t (*)(uint8_t report_id, hid_report_type_t, uint8_t*, uint16_t)
//   set_report_callback_t = void     (*)(uint8_t report_id, hid_report_type_t, const uint8_t*, uint16_t)
//
// ATENÇÃO: o primeiro parâmetro É o report_id, não 'instance'.
// O TinyUSB REMOVE o byte de report_id do buffer antes de chamar o callback —
// portanto buffer[0] é o PRIMEIRO byte do payload, não o report_id.
// ─────────────────────────────────────────────────────────────────────────────

// GET_FEATURE: device → PC (PID Block Load report_id=6, PID Pool report_id=7)
// Chamado quando Windows faz GET_REPORT para um feature report.
static uint16_t get_report_cb(uint8_t report_id,
                               hid_report_type_t type,
                               uint8_t* buffer, uint16_t reqlen) {
    if (USBDevice.HID_Setup_Callback) {
        g_featureReportLen = 0;  // clear stale data BEFORE callback fills it
        Setup s;
        s.bmRequestType = REQUEST_DEVICETOHOST_CLASS_INTERFACE;
        s.bRequest      = HID_GET_REPORT;
        s.wValueL       = report_id;
        s.wValueH       = (uint8_t)type;
        s.wIndex        = 0;
        s.wLength       = reqlen;
        USBDevice.HID_Setup_Callback(s);  // ffb.ino::HID_GetReport fills g_featureReportBuf
    }
    uint16_t n = (g_featureReportLen < reqlen) ? g_featureReportLen : reqlen;
    if (n) {
        memcpy(buffer, g_featureReportBuf, n);
        g_featureReportLen = 0;
        // Debug: confirm payload (WITHOUT reportId) sent to TinyUSB
        Serial.printf("[USB] GET_FEATURE id=0x%02X payload_len=%u buf[0]=0x%02X buf[1]=0x%02X\n",
                      report_id, n,
                      n > 0 ? buffer[0] : 0xFF,
                      n > 1 ? buffer[1] : 0xFF);
    }
    return n;
}

// SET_REPORT: OUTPUT reports (FFB commands) + SET_FEATURE (Create New Effect etc.)
// O TinyUSB remove o report_id do buffer — está separado no parâmetro report_id.
static void set_report_cb(uint8_t report_id,
                           hid_report_type_t type,
                           uint8_t const* buffer, uint16_t bufsize) {
    if (type == HID_REPORT_TYPE_OUTPUT) {
        // ── OUTPUT: FFB command → FfbOnUsbData() ──────────────────────────────
        // FfbOnUsbData() espera data[0]=report_id, mas TinyUSB já removeu o byte.
        // Reconstitui: [report_id, payload...]
        if (!USBDevice.HID_ReceiveReport_Callback) return;
        uint8_t buf[65];
        buf[0] = report_id;
        uint16_t n = (bufsize > 64) ? 64 : bufsize;
        memcpy(buf + 1, buffer, n);
        USBDevice.HID_ReceiveReport_Callback(buf, n + 1);

    } else {
        // ── SET_FEATURE: Create New Effect (report_id=5/0x15) etc. ────────────
        // FIX: prepend report_id then payload, matching what USB_RecvControl
        // callers expect (struct starts with reportId byte).
        // TinyUSB strips report_id from buffer, so we add it back manually.
        {
            s_featureBuf[0] = report_id;  // restore stripped report_id
            uint16_t n = (bufsize > 63) ? 63 : (uint16_t)bufsize;
            memcpy(s_featureBuf + 1, buffer, n);
            s_featureLen = (int)(n + 1);
            s_recvReady  = true;  // data is ready BEFORE callback fires
            Serial.printf("[USB] SET_FEATURE id=0x%02X len=%u buf[0]=0x%02X\n",
                          report_id, n, buffer[0]);
        }
        if (USBDevice.HID_Setup_Callback) {
            Setup s;
            s.bmRequestType = REQUEST_HOSTTODEVICE_CLASS_INTERFACE;
            s.bRequest      = HID_SET_REPORT;
            s.wValueL       = report_id;
            s.wValueH       = (uint8_t)type;
            s.wIndex        = 0;
            s.wLength       = bufsize;
            USBDevice.HID_Setup_Callback(s);
        }
    }
}

// ─────────────────────────────────────────────────────────────────────────────
// API pública
// ─────────────────────────────────────────────────────────────────────────────

// Adafruit_USBD_HID 3.7.4 defines tud_hid_set/get_report_cb as non-weak and
// routes ALL report types (OUTPUT + FEATURE) to our registered callback.
// No override needed — just register via setReportCallback().
void ESP32_HID_Init() {
    // Com USB Mode=TinyUSB + CDC On Boot=Enabled:
    // O core Arduino já inicializou o CDC (Serial) via Adafruit TinyUSB.
    // clearConfiguration() chamado dentro de Serial.begin() sobrescreveu as
    // strings com o macro USB_PRODUCT do board ("ESP32S3_DEV").
    // Redefinimos AQUI, depois adicionamos o HID e forçamos re-enumeração.

    // 1) Corrige strings ANTES de begin() adicionar o HID
    TinyUSBDevice.setManufacturerDescriptor("Jean-DrEaD");
    TinyUSBDevice.setProductDescriptor("ESP32-S3-FFB-Wheel");

    // 2) Adiciona HID ao dispositivo composto
    s_HID.setReportCallback(get_report_cb, set_report_cb);
    s_HID.begin();

    // 3) Força re-enumeração USB via API TinyUSB de baixo nível.
    //    Adafruit_USBD_Device 3.7.4 não expõe disconnect()/connect().
    //    tud_disconnect() / tud_connect() estão em tusb.h (já incluído).
    tud_disconnect();
    delay(50);
    tud_connect();

    // 4) Aguarda enumeração com HID (máx 3s)
    uint32_t t = millis();
    while (!TinyUSBDevice.mounted() && (millis()-t) < 3000) { delay(10); }
}

bool ESP32_HID_Ready() {
    return TinyUSBDevice.mounted();
}

void HID_SendReport(uint8_t id, const void* data, int len) {
    if (!s_HID.ready()) return;
    s_HID.sendReport(id, data, (uint8_t)len);
}

void USB_SendControl(uint8_t /*flags*/, const void* data, int len) {
    // ─── CRITICAL FIX ─────────────────────────────────────────────────────────
    // TinyUSB's get_report_cb is expected to fill `buffer` with PAYLOAD only —
    // it automatically prepends the report_id byte on the wire.
    // The structs (PIDPool, PIDBlockLoad, etc.) all start with a reportId byte.
    // If we copy the whole struct, TinyUSB adds a second report_id prefix →
    // malformed GET_FEATURE response → Windows reads garbage field values:
    //   PIDPool:      ramPoolSize gets corrupted  → driver can't set up memory
    //   PIDBlockLoad: effectBlockIndex = reportId → block allocation fails
    // Fix: skip the first byte (reportId) before storing in g_featureReportBuf.
    // ──────────────────────────────────────────────────────────────────────────
    if (len <= 1) return;
    const uint8_t* p = (const uint8_t*)data + 1;  // skip reportId byte
    int actual = len - 1;
    uint16_t n = (actual < (int)sizeof(g_featureReportBuf))
                     ? (uint16_t)actual : (uint16_t)sizeof(g_featureReportBuf);
    memcpy(g_featureReportBuf, p, n);
    g_featureReportLen = n;
}

int USB_RecvControl(void* data, int len) {
    // FIX: data is already in s_featureBuf (copied by set_report_cb before
    // HID_Setup_Callback fires). Just copy it out — no waiting needed.
    if (!s_recvReady) {
        // Fallback wait in case called outside of set_report_cb context
        uint32_t t = millis();
        while (!s_recvReady && (millis() - t) < 5) { yield(); }
    }
    if (!s_recvReady) return 0;
    int n = (len < s_featureLen) ? len : s_featureLen;
    if (n > 0) memcpy(data, s_featureBuf, (size_t)n);
    s_recvReady  = false;
    s_featureLen = 0;
    return n;
}

// ─────────────────────────────────────────────────────────────────────────────
// Joystick send methods
// ─────────────────────────────────────────────────────────────────────────────
void Joystick_::send_16_16_12_12_12_28(uint16_t x,uint16_t y,uint16_t z,
                                        uint16_t rx,uint16_t ry,uint32_t b) {
    uint8_t j[12];
    j[0]=(uint8_t)x;   j[1]=(uint8_t)(x>>8);
    j[2]=(uint8_t)y;   j[3]=(uint8_t)(y>>8);
    j[4]=(uint8_t)z;
    j[5]=(uint8_t)(((z>>8)&0xF)|((rx&0xF)<<4));
    j[6]=(uint8_t)(rx>>4);
    j[7]=(uint8_t)ry;
    // PACKING ORIGINAL — obrigatório para compatibilidade com Wheel Control:
    // j[8][3:0] = RY high nibble
    // j[8][7:4] = buttons bits[3:0] → campo HAT no descriptor
    //             Com BUTTON0-3 mapeados ao pino 48 (sempre HIGH=nao pressionado),
    //             bits 0-3 ficam em 0 → HAT = 0 = sem direcao
    // j[9]  = buttons bits[4-11]  → Button1..8 no Wheel Control
    // j[10] = buttons bits[12-19] → Button9..16
    // j[11] = buttons bits[20-27] → Button17..24
    // BUTTON4=GPIO5→Button1, BUTTON5=GPIO6→Button2, BUTTON6=GPIO7→Button3
    j[8]=(uint8_t)(((ry>>8)&0xF)|((b&0xF)<<4));
    j[9]=(uint8_t)(b>>4); j[10]=(uint8_t)(b>>12); j[11]=(uint8_t)(b>>20);
    HID_SendReport(4,j,12);
}
void Joystick_::send_8(int8_t x,uint8_t y,uint8_t z,uint8_t b){uint8_t j[4]={(uint8_t)x,y,z,b};HID_SendReport(4,j,4);}
void Joystick_::send_16(int16_t x,uint16_t y,uint16_t z,uint8_t b){uint8_t j[7];j[0]=(uint8_t)x;j[1]=(uint8_t)(x>>8);j[2]=(uint8_t)y;j[3]=(uint8_t)(y>>8);j[4]=(uint8_t)z;j[5]=(uint8_t)(z>>8);j[6]=b;HID_SendReport(4,j,7);}
void Joystick_::send_16_12_12(int16_t x,uint16_t y,uint16_t z,uint8_t b){uint8_t j[5];j[0]=(uint8_t)x;j[1]=(uint8_t)(((x>>8)&0xF)|((y&0xF)<<4));j[2]=(uint8_t)(y>>4);j[3]=(uint8_t)z;j[4]=(uint8_t)(((z>>8)&0xF)|((b&0xF)<<4));HID_SendReport(4,j,5);}
void Joystick_::send_16_16_12(int16_t x,uint16_t y,uint16_t z,uint16_t b){uint8_t j[7];j[0]=(uint8_t)x;j[1]=(uint8_t)(x>>8);j[2]=(uint8_t)y;j[3]=(uint8_t)(y>>8);j[4]=(uint8_t)z;j[5]=(uint8_t)(((z>>8)&0xF)|((b&0xF)<<4));j[6]=(uint8_t)(b>>4);HID_SendReport(4,j,7);}
void Joystick_::send_16_16_10_10_12(int16_t x,uint16_t y,uint16_t z,uint16_t rx,uint32_t b){uint8_t j[8];j[0]=(uint8_t)x;j[1]=(uint8_t)(x>>8);j[2]=(uint8_t)y;j[3]=(uint8_t)(y>>8);j[4]=(uint8_t)z;j[5]=(uint8_t)(((z>>8)&3)|((rx&0x3F)<<2));j[6]=(uint8_t)(((rx>>6)&0xF)|((b&0xF)<<4));j[7]=(uint8_t)(b>>4);HID_SendReport(4,j,8);}
void Joystick_::send_16_16_12_12_32(int16_t x,uint16_t y,uint16_t z,uint16_t rx,uint32_t b){uint8_t j[11];j[0]=(uint8_t)x;j[1]=(uint8_t)(x>>8);j[2]=(uint8_t)y;j[3]=(uint8_t)(y>>8);j[4]=(uint8_t)z;j[5]=(uint8_t)(((z>>8)&0xF)|((rx&0xF)<<4));j[6]=(uint8_t)(rx>>4);j[7]=(uint8_t)b;j[8]=(uint8_t)(b>>8);j[9]=(uint8_t)(b>>16);j[10]=(uint8_t)(b>>24);HID_SendReport(4,j,11);}
void Joystick_::send_16_10_18(int16_t x,uint16_t y,uint16_t z,uint16_t rx,uint32_t b){uint8_t j[8];j[0]=(uint8_t)x;j[1]=(uint8_t)(x>>8);j[2]=(uint8_t)rx;j[3]=(uint8_t)(((rx>>8)&3)|((z&0x3F)<<2));j[4]=(uint8_t)(((z>>6)&0xF)|((y&0xF)<<4));j[5]=(uint8_t)(((y>>4)&0x3F)|((b&3)<<6));j[6]=(uint8_t)(b>>2);j[7]=(uint8_t)(b>>10);HID_SendReport(4,j,8);}
void Joystick_::send_16_8_32(int16_t x,uint16_t y,uint16_t z,uint16_t rx,uint16_t sx,uint16_t sy,uint32_t b){uint8_t j[11];j[0]=(uint8_t)x;j[1]=(uint8_t)(x>>8);j[2]=(uint8_t)y;j[3]=(uint8_t)z;j[4]=(uint8_t)rx;j[5]=(uint8_t)sx;j[6]=(uint8_t)sy;j[7]=(uint8_t)b;j[8]=(uint8_t)(b>>8);j[9]=(uint8_t)(b>>16);j[10]=(uint8_t)(b>>24);HID_SendReport(4,j,11);}
void Joystick_::send_16_16_12_12_12_12_32(int16_t x,uint16_t y,uint16_t z,uint16_t rx,uint16_t ry,uint16_t rz,uint32_t b){uint8_t j[14];j[0]=(uint8_t)x;j[1]=(uint8_t)(x>>8);j[2]=(uint8_t)y;j[3]=(uint8_t)(y>>8);j[4]=(uint8_t)z;j[5]=(uint8_t)(((z>>8)&0xF)|((rx&0xF)<<4));j[6]=(uint8_t)(rx>>4);j[7]=(uint8_t)ry;j[8]=(uint8_t)(((ry>>8)&0xF)|((rz&0xF)<<4));j[9]=(uint8_t)(rz>>4);j[10]=(uint8_t)b;j[11]=(uint8_t)(b>>8);j[12]=(uint8_t)(b>>16);j[13]=(uint8_t)(b>>24);HID_SendReport(4,j,14);}
